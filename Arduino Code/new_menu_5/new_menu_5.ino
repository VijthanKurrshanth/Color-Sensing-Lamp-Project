#include <Wire.h>
#include <Adafruit_GFX.h>
#include <Adafruit_SH1106.h>

#define SCREEN_WIDTH 128 // OLED display width, in pixels
#define SCREEN_HEIGHT 64 // OLED display height, in pixels

#define OLED_RESET -1 // Reset pin #
#define SCREEN_ADDRESS 0x3C 
Adafruit_SH1106 display(OLED_RESET);

#define LOGO_HEIGHT   64
#define LOGO_WIDTH    128

//The following are menu screen bitmaps
// 'Lamp Mode', 128x64px
const unsigned char Lamp_Mode [] PROGMEM = {
  0x00, 0x00, 0x00, 0x00, 0x00, 0x00, 0x00, 0x00, 0x00, 0x00, 0x00, 0x00, 0x00, 0x00, 0x00, 0x00, 
  0x00, 0x00, 0x00, 0x00, 0x00, 0x00, 0x00, 0x00, 0x00, 0x00, 0x00, 0x00, 0x00, 0x00, 0x00, 0x00, 
  0x00, 0x00, 0x00, 0x00, 0x00, 0x00, 0x00, 0x00, 0x00, 0x00, 0x00, 0x00, 0x00, 0x00, 0x00, 0x00, 
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  0x00, 0x00, 0x00, 0x00, 0x00, 0x00, 0x00, 0x00, 0x00, 0x00, 0x00, 0x00, 0x00, 0x00, 0x00, 0x00
};
// 'Calibrate', 128x64px
const unsigned char Calibrate [] PROGMEM = {
  0x00, 0x00, 0x00, 0x00, 0x00, 0x00, 0x00, 0x00, 0x00, 0x00, 0x00, 0x00, 0x00, 0x00, 0x00, 0x00, 
  0x00, 0x00, 0x00, 0x00, 0x00, 0x00, 0x00, 0x00, 0x00, 0x00, 0x00, 0x00, 0x00, 0x00, 0x00, 0x00, 
  0x00, 0x00, 0x00, 0x00, 0x00, 0x00, 0x00, 0x00, 0x00, 0x00, 0x00, 0x00, 0x00, 0x00, 0x00, 0x00, 
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  0x00, 0x00, 0x00, 0x00, 0x00, 0x00, 0x00, 0x00, 0x00, 0x00, 0x00, 0x00, 0x00, 0x00, 0x00, 0x00
};
// 'Brightness', 128x64px
const unsigned char Brightness [] PROGMEM = {
  0x00, 0x00, 0x00, 0x00, 0x00, 0x00, 0x00, 0x00, 0x00, 0x00, 0x00, 0x00, 0x00, 0x00, 0x00, 0x00, 
  0x00, 0x00, 0x00, 0x00, 0x00, 0x00, 0x00, 0x00, 0x00, 0x00, 0x00, 0x00, 0x00, 0x00, 0x00, 0x00, 
  0x00, 0x00, 0x00, 0x00, 0x00, 0x00, 0x00, 0x00, 0x00, 0x00, 0x00, 0x00, 0x00, 0x00, 0x00, 0x00, 
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  0x00, 0x00, 0x00, 0x00, 0x00, 0x00, 0x00, 0x00, 0x00, 0x00, 0x00, 0x00, 0x00, 0x00, 0x00, 0x00
};

// Array of all bitmaps for convenience. (Total bytes used to store images in PROGMEM = 3120)
const unsigned char* main_menu[3] = {
  Brightness,
  Calibrate,
  Lamp_Mode
};

// 'Color Cycle', 128x64px
const unsigned char epd_bitmap_Color_Cycle [] PROGMEM = {
  0x00, 0x00, 0x00, 0x00, 0x00, 0x00, 0x00, 0x00, 0x00, 0x00, 0x00, 0x00, 0x00, 0x00, 0x00, 0x00, 
  0x00, 0x00, 0x00, 0x00, 0x00, 0x00, 0x00, 0x00, 0x00, 0x00, 0x00, 0x00, 0x00, 0x00, 0x00, 0x00, 
  0x00, 0x00, 0x00, 0x00, 0x00, 0x00, 0x00, 0x00, 0x00, 0x00, 0x00, 0x00, 0x00, 0x00, 0x00, 0x00, 
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  0x00, 0x00, 0x00, 0x00, 0x00, 0x00, 0x00, 0x00, 0x00, 0x00, 0x00, 0x00, 0x00, 0x00, 0x00, 0x00
};
// 'Custom Color', 128x64px
const unsigned char epd_bitmap_Custom_Color [] PROGMEM = {
  0x00, 0x00, 0x00, 0x00, 0x00, 0x00, 0x00, 0x00, 0x00, 0x00, 0x00, 0x00, 0x00, 0x00, 0x00, 0x00, 
  0x00, 0x00, 0x00, 0x00, 0x00, 0x00, 0x00, 0x00, 0x00, 0x00, 0x00, 0x00, 0x00, 0x00, 0x00, 0x00, 
  0x00, 0x00, 0x00, 0x00, 0x00, 0x00, 0x00, 0x00, 0x00, 0x00, 0x00, 0x00, 0x00, 0x00, 0x00, 0x00, 
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  0x00, 0x00, 0x00, 0x00, 0x00, 0x00, 0x00, 0x00, 0x00, 0x00, 0x00, 0x00, 0x00, 0x00, 0x00, 0x00
};
// 'Color Sensing', 128x64px
const unsigned char epd_bitmap_Color_Sensing [] PROGMEM = {
  0x00, 0x00, 0x00, 0x00, 0x00, 0x00, 0x00, 0x00, 0x00, 0x00, 0x00, 0x00, 0x00, 0x00, 0x00, 0x00, 
  0x00, 0x00, 0x00, 0x00, 0x00, 0x00, 0x00, 0x00, 0x00, 0x00, 0x00, 0x00, 0x00, 0x00, 0x00, 0x00, 
  0x00, 0x00, 0x00, 0x00, 0x00, 0x00, 0x00, 0x00, 0x00, 0x00, 0x00, 0x00, 0x00, 0x00, 0x00, 0x00, 
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  0x00, 0x00, 0x00, 0x00, 0x00, 0x00, 0x00, 0x00, 0x00, 0x00, 0x00, 0x00, 0x00, 0x00, 0x00, 0x00
};

// Array of all bitmaps for convenience. (Total bytes used to store images in PROGMEM = 3120)
const unsigned char* lamp_mode_menu[3] = {
  epd_bitmap_Color_Cycle,
  epd_bitmap_Color_Sensing,
  epd_bitmap_Custom_Color
};

// 'Blue', 128x64px
const unsigned char epd_bitmap_Blue [] PROGMEM = {
  0x00, 0x00, 0x00, 0x00, 0x00, 0x00, 0x00, 0x00, 0x00, 0x00, 0x00, 0x00, 0x00, 0x00, 0x00, 0x00, 
  0x00, 0x00, 0x00, 0x00, 0x00, 0x00, 0x00, 0x00, 0x00, 0x00, 0x00, 0x00, 0x00, 0x00, 0x00, 0x00, 
  0x00, 0x00, 0x00, 0x00, 0x00, 0x00, 0x00, 0x00, 0x00, 0x00, 0x00, 0x00, 0x00, 0x00, 0x00, 0x00, 
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  0x00, 0x00, 0x00, 0x00, 0x00, 0x00, 0x00, 0x00, 0x00, 0x00, 0x00, 0x00, 0x00, 0x00, 0x00, 0x00
};
// 'Green', 128x64px
const unsigned char epd_bitmap_Green [] PROGMEM = {
  0x00, 0x00, 0x00, 0x00, 0x00, 0x00, 0x00, 0x00, 0x00, 0x00, 0x00, 0x00, 0x00, 0x00, 0x00, 0x00, 
  0x00, 0x00, 0x00, 0x00, 0x00, 0x00, 0x00, 0x00, 0x00, 0x00, 0x00, 0x00, 0x00, 0x00, 0x00, 0x00, 
  0x00, 0x00, 0x00, 0x00, 0x00, 0x00, 0x00, 0x00, 0x00, 0x00, 0x00, 0x00, 0x00, 0x00, 0x00, 0x00, 
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  0x00, 0x00, 0x00, 0x00, 0x00, 0x00, 0x00, 0x00, 0x00, 0x00, 0x00, 0x00, 0x00, 0x00, 0x00, 0x00
};
// 'Red', 128x64px
const unsigned char epd_bitmap_Red [] PROGMEM = {
  0x00, 0x00, 0x00, 0x00, 0x00, 0x00, 0x00, 0x00, 0x00, 0x00, 0x00, 0x00, 0x00, 0x00, 0x00, 0x00, 
  0x00, 0x00, 0x00, 0x00, 0x00, 0x00, 0x00, 0x00, 0x00, 0x00, 0x00, 0x00, 0x00, 0x00, 0x00, 0x00, 
  0x00, 0x00, 0x00, 0x00, 0x00, 0x00, 0x00, 0x00, 0x00, 0x00, 0x00, 0x00, 0x00, 0x00, 0x00, 0x00, 
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  0x00, 0x00, 0x00, 0x00, 0x00, 0x00, 0x00, 0x00, 0x00, 0x00, 0x00, 0x00, 0x00, 0x00, 0x00, 0x00
};

// Array of all bitmaps for convenience. (Total bytes used to store images in PROGMEM = 3120)
const unsigned char* custom_color_menu[3] = {
  epd_bitmap_Red,
  epd_bitmap_Green,
  epd_bitmap_Blue
};

// 'White', 128x64px
const unsigned char epd_bitmap_White [] PROGMEM = {
  0x00, 0x00, 0x00, 0x00, 0x00, 0x00, 0x00, 0x00, 0x00, 0x00, 0x00, 0x00, 0x00, 0x00, 0x00, 0x00, 
  0x00, 0x00, 0x00, 0x00, 0x00, 0x00, 0x00, 0x00, 0x00, 0x00, 0x00, 0x00, 0x00, 0x00, 0x00, 0x00, 
  0x00, 0x00, 0x00, 0x00, 0x00, 0x00, 0x00, 0x00, 0x00, 0x00, 0x00, 0x00, 0x00, 0x00, 0x00, 0x00, 
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  0x00, 0x00, 0x00, 0x00, 0x00, 0x00, 0x00, 0x00, 0x00, 0x00, 0x00, 0x00, 0x00, 0x00, 0x00, 0x00
};
// 'Black', 128x64px
const unsigned char epd_bitmap_Black [] PROGMEM = {
  0x00, 0x00, 0x00, 0x00, 0x00, 0x00, 0x00, 0x00, 0x00, 0x00, 0x00, 0x00, 0x00, 0x00, 0x00, 0x00, 
  0x00, 0x00, 0x00, 0x00, 0x00, 0x00, 0x00, 0x00, 0x00, 0x00, 0x00, 0x00, 0x00, 0x00, 0x00, 0x00, 
  0x00, 0x00, 0x00, 0x00, 0x00, 0x00, 0x00, 0x00, 0x00, 0x00, 0x00, 0x00, 0x00, 0x00, 0x00, 0x00, 
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  0x00, 0x00, 0x00, 0x00, 0x00, 0x00, 0x00, 0x00, 0x00, 0x00, 0x00, 0x00, 0x00, 0x00, 0x00, 0x00
};

// Array of all bitmaps for convenience. (Total bytes used to store images in PROGMEM = 2080)
const unsigned char* calibrate_menu[2] = {
  epd_bitmap_Black,
  epd_bitmap_White
};

// 'column2', 50x64px
const unsigned char column2 [] PROGMEM = {
	0x00, 0x00, 0x00, 0x00, 0x00, 0x00, 0x00, 0x00, 0x00, 0x00, 0x00, 0x00, 0x00, 0x00, 0x78, 0x10, 
	0x00, 0x40, 0x00, 0x00, 0x00, 0x44, 0x00, 0x00, 0x40, 0x00, 0x00, 0x00, 0x44, 0x70, 0x78, 0x44, 
	0x00, 0x00, 0x00, 0x44, 0x10, 0x44, 0x48, 0x00, 0x00, 0x00, 0x78, 0x10, 0x44, 0x50, 0x00, 0x00, 
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	0x00, 0x00, 0x00, 0x00, 0x00, 0x00, 0x00, 0x00, 0x00, 0x00, 0x00, 0x00, 0x00, 0x00, 0x00, 0x00
};
// 'column1', 50x64px
const unsigned char column1 [] PROGMEM = {
	0x00, 0x00, 0x00, 0x00, 0x00, 0x00, 0x00, 0x00, 0x00, 0x00, 0x00, 0x00, 0x00, 0x00, 0x3c, 0x00, 
	0x02, 0x00, 0x00, 0x00, 0x00, 0x22, 0x00, 0x02, 0x00, 0x00, 0x00, 0x00, 0x22, 0x1c, 0x1e, 0x00, 
	0x00, 0x00, 0x00, 0x22, 0x22, 0x22, 0x00, 0x00, 0x00, 0x00, 0x3c, 0x22, 0x22, 0x00, 0x00, 0x00, 
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	0x00, 0x00, 0x00, 0x00, 0x00, 0x00, 0x1c, 0x00, 0x00, 0x00, 0x00, 0x00, 0x00, 0x00, 0x00, 0x00
};
// Array of all bitmaps for convenience. (Total bytes used to store images in PROGMEM = 928)
const unsigned char* color_column[2] = {
	column1,
	column2
};

// 'triangle', 5x9px
const unsigned char triangle [] PROGMEM = {
	0x08, 0x18, 0x38, 0x78, 0xf8, 0x78, 0x38, 0x18, 0x08
};
const unsigned char* triangle_pointer = triangle;

//defining pins
//sensor pins
#define S0 4 
#define S1 12
#define S2 13
#define S3 7
#define sensorOut 8
#define sensorPower 10
//touch input
#define DOWN_PIN 0
#define ENTER_PIN 1
#define EXIT_PIN 2
//LED pins
#define RED_PIN 3
#define GREEN_PIN 5
#define BLUE_PIN 6
#define RGB_GND 9


int i = 2; //used for menu navigation

int w = 128, h = 15; //used for brightnes adjustments
unsigned int BRIGHT = 0; //used for brightnes adjustments

unsigned int max_red = 3878, max_green = 4729, max_blue = 3315; //measured values for color sensor
unsigned int min_red = 670, min_green = 690, min_blue = 490; //measured values for color sensor

int RED = 255, GREEN = 255, BLUE = 255; //initial output color of led is white

unsigned long screen_timeout = 0; // used for screen timeout


void setup() {
  Serial.begin(9600);
  Wire.begin();
  display.begin(SH1106_SWITCHCAPVCC, SCREEN_ADDRESS);
  pinMode(DOWN_PIN, INPUT);
  pinMode(ENTER_PIN, INPUT);
  pinMode(EXIT_PIN, INPUT);
  pinMode(RED_PIN, OUTPUT);
  pinMode(GREEN_PIN, OUTPUT);
  pinMode(BLUE_PIN, OUTPUT);
  pinMode(S0, OUTPUT);
  pinMode(S1, OUTPUT);
  pinMode(S2, OUTPUT);
  pinMode(S3, OUTPUT);
  pinMode(sensorOut, INPUT);
  pinMode(sensorPower, OUTPUT);

  // TURN OFF sensor for now
  digitalWrite(S0,LOW);
  digitalWrite(S1,LOW);
  digitalWrite(sensorPower,LOW);
}
void loop() {

  analogWrite(RGB_GND, 255-BRIGHT);
  analogWrite(BLUE_PIN, 255-BLUE);
  analogWrite(GREEN_PIN, 255-GREEN);
  analogWrite(RED_PIN, 255-RED);
  
  
  int j = 0;
  
  print_scrn(main_menu[i]);

  if (digitalRead(ENTER_PIN) == HIGH && i == 0) {
    delay(250);
    print_brightness();
    delay(250);
  }
  
  if (digitalRead(ENTER_PIN) == HIGH && i == 1) {
    delay(250);
    for(;;) {
      print_scrn(calibrate_menu[j]);
      
      if (digitalRead(ENTER_PIN) == HIGH && j == 0) {

        calibrating('B');

      }
      if (digitalRead(ENTER_PIN) == HIGH && j == 1) {

        calibrating('W');

      }
      
      if (digitalRead(DOWN_PIN) == HIGH) {
        j++;
      }
      if (j == 2) {
        j = 0;
      }
      if (digitalRead(EXIT_PIN) == HIGH) {
        screen_timeout = millis();
        break;
      }

    }
  }
    
  if (digitalRead(ENTER_PIN) == HIGH && i == 2) {
    delay(250);
    for(;;) {
      
      print_scrn(lamp_mode_menu[j]);

      if (digitalRead(ENTER_PIN) == HIGH && j == 2) {
        delay(250);
        int k = 0;
        uint16_t x0 = 52; uint16_t y0 = 2; //uint16_t x1 = x0+10; uint16_t y1 = y0-4; uint16_t x2 = x0+10; uint16_t y2 = y0+4;
        for(;;) {
          
          display.clearDisplay();
          display.drawBitmap(0,0,color_column[0], 50, LOGO_HEIGHT, 1);
          display.drawBitmap(65,0,color_column[1], 50, LOGO_HEIGHT, 1);
          

          //display.fillTriangle(x0 + 64*(k/5), y0 + 10*(k - (k/5)), x1, y1, x2, y2, 1);
          display.drawBitmap(x0 + 64*(k/6), y0 + 10*(k - 6*(k/6)), triangle_pointer, 5, 10, 1);
          display.display();
          delay(250);

          if (digitalRead(DOWN_PIN) == HIGH) {
            k++;
          }

          if (k==12){
            k = 0;
          }

          if (digitalRead(ENTER_PIN) == HIGH && k == 0) { //red
            RED = 255; GREEN = 0; BLUE = 0;
          }

          if (digitalRead(ENTER_PIN) == HIGH && k == 1) { //blue
            RED = 0; GREEN = 0; BLUE = 255;
          }

          if (digitalRead(ENTER_PIN) == HIGH && k == 2) { //green
            RED = 0; GREEN = 255; BLUE = 0;
          }

          if (digitalRead(ENTER_PIN) == HIGH && k == 3) { //yellow
            RED = 216; GREEN = 39; BLUE = 0;
          }

          if (digitalRead(ENTER_PIN) == HIGH && k == 4) { //purple
            RED = 143; GREEN = 38; BLUE = 172;
          }

          if (digitalRead(ENTER_PIN) == HIGH && k == 5) { // orange
            RED = 246; GREEN = 9; BLUE = 0;
          }

          if (digitalRead(ENTER_PIN) == HIGH && k == 6) { //pink
            RED = 235; GREEN = 0; BLUE = 21;
          }

          if (digitalRead(ENTER_PIN) == HIGH && k == 7) { //white
            RED = 255; GREEN = 255; BLUE = 255;
          }

          if (digitalRead(ENTER_PIN) == HIGH && k == 8) { //teal
            RED = 0; GREEN = 100; BLUE = 160;
          }

          if (digitalRead(ENTER_PIN) == HIGH && k == 9) { //navy
            RED = 0; GREEN = 31; BLUE = 101;
          }

          if (digitalRead(ENTER_PIN) == HIGH && k == 10) { //mint
            RED = 119; GREEN = 210; BLUE = 162;
          }

          if (digitalRead(ENTER_PIN) == HIGH && k == 11) { //custom
            int l = 0;
            for(;;){
              print_scrn(custom_color_menu[l]);
              if (digitalRead(ENTER_PIN) == HIGH){
                if (l == 0){
                  RED = set_value(RED, "R");
                }
                else if (l == 1){
                  GREEN = set_value(GREEN, "G");
                }
                else if (l == 2){
                  BLUE = set_value(BLUE, "B");
                }
              }
              if (digitalRead(DOWN_PIN) == HIGH) {
                l++;
              }
              if (l == 3) {
                l = 0;
              }
              if (digitalRead(EXIT_PIN) == HIGH) {
                break;
              }
            }
          }

          analogWrite(BLUE_PIN, 255-BLUE);
          analogWrite(GREEN_PIN, 255-GREEN);
          analogWrite(RED_PIN, 255-RED);
          if (digitalRead(EXIT_PIN) == HIGH) {
            break;
          }
        }
      }
      
      if (digitalRead(ENTER_PIN) == HIGH && j == 0) {
          color_cycle();
          delay(250);
      }

      if (digitalRead(ENTER_PIN) == HIGH && j == 1) {
        
        color_sense();
        
      }
      
      if (digitalRead(DOWN_PIN) == HIGH) {
        j++;
      }
      if (j == 3) {
        j = 0;
      }
      if (digitalRead(EXIT_PIN) == HIGH) {
        screen_timeout = millis();
        break;
      }
      analogWrite(BLUE_PIN, 255-BLUE);
      analogWrite(GREEN_PIN, 255-GREEN);
      analogWrite(RED_PIN, 255-RED);
    }
  }

  if (digitalRead(DOWN_PIN) == HIGH) {
    i++;
    screen_timeout = millis();
  }
  if (i == 3) {
    i = 0;
  }
  
  if (millis() >= screen_timeout + 10000){
    for(;;){
      display.clearDisplay();
      display.display();
      if (digitalRead(ENTER_PIN) == HIGH || digitalRead(DOWN_PIN) == HIGH || digitalRead(EXIT_PIN) == HIGH){
        delay(250);
        screen_timeout = millis();
        break;
      }
    }
    
  }
}

void print_scrn (const unsigned char* pointer){
  display.clearDisplay();
  display.drawBitmap(0,0,pointer, LOGO_WIDTH, LOGO_HEIGHT, 1);
  display.display();
  delay(250);
}

void print_brightness (void){
  for(;;){
    display.clearDisplay();
    display.setTextColor(WHITE);
    display.setTextSize(1);
    display.setCursor(0,0);
    display.print("Adjust Brightness");
    display.setCursor(45,40);
    float p = w/128.0*100;
    
    delay(250);
    int temp_w = w; 
    if (digitalRead(EXIT_PIN) == HIGH && w<=128){
      w = w + 16;
      delay(250);
    }
    if (digitalRead(DOWN_PIN) == HIGH && w<=128){
      w = w - 16;
      delay(250);
    }
    if (w>128){
      w = 128;
    }
    else if (w<0){
      w = 0;
    }
    display.print(p);
    display.print(" %");
    display.fillRect(0, 20, w, h, 1);
    display.display();
    
    BRIGHT = int(round(map(w, 0, 128, 255, 0)));
    analogWrite(RGB_GND, 255-BRIGHT);

    if (digitalRead(ENTER_PIN) == HIGH){
      screen_timeout = millis();
      return;
    }
    
  }
    
    
}

//function to set values for R G B values
unsigned int set_value (unsigned int value, char color){
  unsigned int digit[3] = {value/100, (value/10)%10, value%10};
  int n = 0;
  for(;;){
    delay(250);
    display.clearDisplay();
    display.setTextColor(WHITE);
    display.setTextSize(1);
    display.setCursor(0,0);
    display.print("Set Value");
    display.setCursor(20,21);
    display.setTextSize(3);
    display.print(digit[0]);
    display.print(" ");
    display.print(digit[1]);
    display.print(" ");
    display.print(digit[2]);
    display.fillRect(20 + 36*n, 55, 15, 5, 1);
    display.display();
    if (digitalRead(ENTER_PIN) == HIGH && n != 3){
      n ++;
      delay(250);
      
    }
    else if (n == 3){
      break;
    }
    if (n == 0){
      if (digit[n] < 3 && digitalRead(DOWN_PIN) == HIGH){
        digit[n] ++;
        delay(250);
      }
      else if (digit[n] < 3 && digitalRead(EXIT_PIN) == HIGH){
        digit[n] --;
        delay(250);
      }
      if (digit[n] == 3){
        digit[n] = 0;
      }
      else if (digit[n] == -1){
        digit[n] = 2;
      }
      
    }
    if (n == 1 || n == 2){
      if (digit[n] < 10 && digitalRead(DOWN_PIN) == HIGH && digit[0] != 2){
        digit[n] ++;
        delay(250);
      }
      else if (digit[n] < 10 && digitalRead(EXIT_PIN) == HIGH && digit[0] != 2){
        digit[n] --;
        delay(250);
      }
      else if (digit[n] < 10 && digit[0] == 2){
        if (digitalRead(DOWN_PIN) == HIGH){
          digit[n] ++;
        }
        else if (digitalRead(EXIT_PIN) == HIGH){
          digit[n] --;
        }
        if (digit[n] > 5){
          digit[n] = 0;
        }
        else if (digit[n] == -1){
          digit[n] = 5;
        }
        
      }
      
      if (digit[n] == 10 && digit[0] != 2){
        digit[n] = 0;
      }
      else if (digit[n] == -1 && digit[0] != 2){
        digit[n] = 9;
      }
      
    }
    
  }
  unsigned int value1 = digit[0]*100 + digit[1]*10 + digit[2];
  return (value1);
}

//function for color cycle mode
void color_cycle (void){
  for(;;){
    int rgbColour[3];
    
    // Start off with red.
    rgbColour[0] = 255;
    rgbColour[1] = 0;
    rgbColour[2] = 0; 
  
    // Choose the colours to increment and decrement.
    for (int decColour = 0; decColour < 3; decColour += 1) {
      int incColour = decColour == 2 ? 0 : decColour + 1;
  
      // cross-fade the two colours.
      for(int i = 0; i < 255; i += 1) {
        rgbColour[decColour] -= 1;
        rgbColour[incColour] += 1;
  
        analogWrite(BLUE_PIN, 255-rgbColour[2]);
        analogWrite(GREEN_PIN, 255-rgbColour[1]);
        analogWrite(RED_PIN, 255-rgbColour[0]);
        delay(5);
        display.clearDisplay();
        display.setTextColor(WHITE);
        display.setTextSize(2);
        display.setCursor(0,0);
        display.print("R : ");
        display.print(rgbColour[0]);
        display.setCursor(0,21);
        display.print("G : ");
        display.print(rgbColour[1]);
        display.setCursor(0,42);
        display.print("B : ");
        display.print(rgbColour[2]);
        display.display();
        if (digitalRead(EXIT_PIN) == HIGH || digitalRead(DOWN_PIN) == HIGH){
          return;
        }
      }
    }
  }
}

//function for calibrating the sensor
void calibrating(char x){
  // Set Pulse Width scaling to 20%
  digitalWrite(sensorPower,HIGH);
  digitalWrite(S0,LOW);
  digitalWrite(S1,HIGH);
  delay(500);

  display.clearDisplay();
  display.setTextColor(WHITE);
  display.setTextSize(1);
  display.setCursor(0,0);
  display.print("Calibrating.....");
  display.display();

  if (x == 'B'){
    unsigned int red_value = getRedPW();
    for (int i=0; i < 10; i++) {
      unsigned int temp_red = getRedPW();
      if (red_value <= temp_red){
        red_value = temp_red;
      }
    }
    unsigned int green_value = getGreenPW();
    for (int i=0; i < 10; i++) {
      unsigned int temp_green = getGreenPW();
      if (green_value <= temp_green){
        green_value = temp_green;
      }
    }
    unsigned int blue_value = getBluePW();
    for (int i=0; i < 10; i++) {
      unsigned int temp_blue = getBluePW();
      if (blue_value <= temp_blue){
        blue_value = temp_blue;
      }
    }
    max_red = red_value;
    max_green = green_value;
    max_blue = blue_value;
  }

  if (x == 'W'){
    unsigned int red_value = getRedPW();
    for (int i=0; i < 10; i++) {
      unsigned int temp_red = getRedPW();
      if (red_value >= temp_red){
        red_value = temp_red;
      }
    }
    unsigned int green_value = getGreenPW();
    for (int i=0; i < 10; i++) {
      unsigned int temp_green = getGreenPW();
      if (green_value >= temp_green){
        green_value = temp_green;
      }
    }
    unsigned int blue_value = getBluePW();
    for (int i=0; i < 10; i++) {
      unsigned int temp_blue = getBluePW();
      if (blue_value >= temp_blue){
        blue_value = temp_blue;
      }
    }
    min_red = red_value;
    min_green = green_value;
    min_blue = blue_value;
  }
  
  display.clearDisplay();
  display.setCursor(0,0);
  display.print("Done :)");
  display.display();
  delay(1000);

  // TURN OFF
  digitalWrite(S0,LOW);
  digitalWrite(S1,LOW);
  digitalWrite(S2,LOW);
  digitalWrite(S3,LOW);
  digitalWrite(sensorPower,LOW);

  return;
}

// Function to read Red Pulse Widths
int getRedPW() {

  // Set sensor to read Red only
  digitalWrite(S2,LOW);
  digitalWrite(S3,LOW);
  // Delay to stabilize sensor
  delay(300);
  // Define integer to represent Pulse Width
  int PW;
  // Read the output Pulse Width
  PW = pulseIn(sensorOut, LOW);
  // Return the value
  return PW;

}

// Function to read Green Pulse Widths
int getGreenPW() {

  // Set sensor to read Green only
  digitalWrite(S2,HIGH);
  digitalWrite(S3,HIGH);
  // Delay to stabilize sensor
  delay(300);
  // Define integer to represent Pulse Width
  int PW;
  // Read the output Pulse Width
  PW = pulseIn(sensorOut, LOW);
  // Return the value
  return PW;

}

// Function to read Blue Pulse Widths
int getBluePW() {

  // Set sensor to read Blue only
  digitalWrite(S2,LOW);
  digitalWrite(S3,HIGH);
  // Delay to stabilize sensor
  delay(300);
  // Define integer to represent Pulse Width
  int PW;
  // Read the output Pulse Width
  PW = pulseIn(sensorOut, LOW);
  // Return the value
  return PW;

}

//function to sense color and output color
void color_sense(void){
  // Set Pulse Width scaling to 20%
  digitalWrite(sensorPower,HIGH);
  digitalWrite(S0,LOW);
  digitalWrite(S1,HIGH);
  delay(500);

  for (;;){
    
    display.clearDisplay();
    display.setTextColor(WHITE);
    display.setTextSize(2);
    display.setCursor(0,0);
    display.print("R : ");
    display.print(RED);
    display.setCursor(0,21);
    display.print("G : ");
    display.print(GREEN);
    display.setCursor(0,42);
    display.print("B : ");
    display.print(BLUE);
    display.display();
  
    // Read Red Pulse Width
    RED = map(getRedPW(), min_red, max_red, 255, 0);
  
    // Read Green Pulse Width
    GREEN = map(getGreenPW(), min_green, max_green, 255, 0);
  
    // Read Blue Pulse Width
    BLUE = map(getBluePW(), min_blue, max_blue, 255, 0);

    BLUE = BLUE-120; GREEN = GREEN-135; RED = RED-110;

    if (RED > 255){
      RED = 255;
    }
    if (GREEN > 255){
      GREEN = 255;
    }
    if (BLUE > 255){
      BLUE = 255;
    }
    if (RED < 0){
      RED = 0;
    }
    if (GREEN < 0){
      GREEN = 0;
    }
    if (BLUE < 0){
      BLUE = 0;
    }
    
    analogWrite(BLUE_PIN, 255-BLUE);
    analogWrite(GREEN_PIN, 255-GREEN);
    analogWrite(RED_PIN, 255-RED);
    
    if (digitalRead(EXIT_PIN) == HIGH || digitalRead(DOWN_PIN) == HIGH){
      break;
    }
  }
  delay(200);
  // TURN OFF sensor
  digitalWrite(S0,LOW);
  digitalWrite(S1,LOW);
  digitalWrite(S2,LOW);
  digitalWrite(S3,LOW);
  digitalWrite(sensorPower,LOW);
}


